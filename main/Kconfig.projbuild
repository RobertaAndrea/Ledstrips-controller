## main/Kconfig.projbuild
```kconfig
menu "Example Configuration"

    config ESP_WIFI_SSID
        string "new WiFi SSID"
        default "LedStrip"
        help
            SSID (network name) for the example to connect to.

    config ESP_WIFI_PASSWORD
        string "new WiFi Password"
        default "12345678"
        help
            WiFi password (WPA or WPA2) for the example to use.

    config ESP_MAX_STA_CONN
        int "Maximal STA connections"
        default 4
        help
            Max number of the STA connects to AP.
endmenu
```
